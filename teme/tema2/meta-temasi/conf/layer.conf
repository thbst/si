## teme/tema2/meta-temasi/conf/layer.conf
```bitbake
# We have a conf and classes directory, add to BBPATH
BBPATH .= ":${LAYERDIR}"

# We have recipes-* directories, add to BBFILES
BBFILES += "${LAYERDIR}/recipes-*/*/*.bb \
	${LAYERDIR}/recipes-*/*/*.bbappend"

BBFILE_COLLECTIONS += "temasi"
BBFILE_PATTERN_temasi = "^${LAYERDIR}/"
BBFILE_PRIORITY_temasi = "6"
```
